;**************************************************
;* Pyrope CortexA9MPCORE
;* Init Script for TRACE32
;**************************************************

sys.res
SYStem.CPU CORTEXA9MPCORE

sys.CONFIG.CORENUMBER 4.
CORE.NUM 4.

SYStem.JtagClock 10Mhz
SYStem.Option ResBreak OFF
SYStem.Option waitreset on
SYStem.Option EnReset ON

sys.config.COREBASE 0x80110000 0x80112000 0x80114000 0x80116000

;sys.CONFIG.CTIBASE 0x80008000 0x80109000 0x8010a000 0x8010b000

tronchip.set DABORT off
tronchip.set PABORT off
;tronchip.set RESET off
tronchip.set UNDEF off

;setup.var %DECIMAL %HEX %TYPE

sys.mode.a

term.reset
if !window.name("Term")
(
	TERM.SCROLL ON
	TERM.SIZE 80 120
;	TERM.GATE
)

if run()
	break
enddo
